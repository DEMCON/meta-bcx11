## conf/layer.conf
```bitbake
BBPATH .= ":${LAYERDIR}"

# We have a recipes-* directories, add to BBFILES
BBFILES += "${LAYERDIR}/recipes-*/*/*.bb \
            ${LAYERDIR}/recipes-*/*/*.bbappend"

BBFILE_COLLECTIONS += "bcx11-layer"
BBFILE_PATTERN_bcx11-layer = "^${LAYERDIR}/"
BBFILE_PRIORITY_bcx11-layer = "8"

LAYERVERSION_bcx11-layer = "1"
LAYERSERIES_COMPAT_bcx11-layer = "zeus dunfell"
LAYERDEPENDS_bcx11-layer = "intel"

SDKMACHINE ?= "x86_64"

MACHINE_FEATURES = "alsa efi pci rtc screen touchscreen usbhost"

DISTRO_FEATURES_remove = "irda pcmcia pci 3g nfc zeroconf x11 wayland vulkan ptest pulse"
DISTRO_FEATURES_append = " opengl alsa systemd"

PACKAGECONFIG_append_pn-mesa = " gbm gles egl"

# Let us add layer-specific bbappends which are only applied when that
# layer is included in our configuration
BBFILES += "${@' '.join('${LAYERDIR}/dynamic-layers/%s/recipes*/*/*.bbappend' % layer \
               for layer in BBFILE_COLLECTIONS.split())}"
BBFILES += "${@' '.join('${LAYERDIR}/dynamic-layers/%s/recipes*/*/*.bb' % layer \
               for layer in BBFILE_COLLECTIONS.split())}"
```

## conf/machine/bcx11.conf
```bitbake
#@TYPE: Machine
#@NAME: intel-corei7-64

#@DESCRIPTION: Machine configuration for 64 bit Intel Core i7 CPU (and later) with MMX, SSE, SSE2, SSE3, and SSSE3 instruction set support. Supports a moderately wide range of drivers that should boot and be usable on "typical" hardware.

require conf/machine/include/meta-intel.inc
require conf/machine/include/intel-corei7-64-common.inc
require conf/machine/include/intel-common-pkgarch.inc

MACHINE_FEATURES += "intel-ucode"

# these are very much recommended for full functionality
MACHINE_ESSENTIAL_EXTRA_RRECOMMENDS_append = " \
    linux-firmware-i915 \
    kernel-module-i915 \
    kernel-module-snd-intel-sst-acpi \
    kernel-module-snd-soc-sst-atom-hifi2-platform \
    kernel-module-snd-soc-sst-cht-bsw-rt5645 \
    linux-firmware-intel-sst-22a8 \
    alsa-ucm-state \
    kernel-module-smsc95xx \
    kernel-module-gpio-pca953x \
"

VIRTUAL-RUNTIME_init_manager = "systemd"
VIRTUAL-RUNTIME_initscripts = ""

PREFERRED_PROVIDER_udev ?= "systemd"
PREFERRED_PROVIDER_udev-utils ?= "systemd"

PREFERRED_PROVIDER_virtual/kernel = "linux-intel"

PREFERRED_PROVIDER_virtual/bootloader = "grub-efi"
EFI_PROVIDER = "grub-efi"

PREFERRED_PROVIDER_virtual/egl = "mesa"
PREFERRED_PROVIDER_virtual/libgles1 = "mesa"
PREFERRED_PROVIDER_virtual/libgles2 = "mesa"
PREFERRED_PROVIDER_virtual/libgl = "mesa"

#Set Qt to commercial version and static build
QT_EDITION = "commercial"

# qemu support
QEMU_TARGETS = "x86_64"
QB_SYSTEM_NAME_bcx11 = "qemu-system-x86_64"
QB_MEM_bcx11 = "-m 2048"
QB_CPU_bcx11 = "-cpu Nehalem"

# make sure qemu uses gl too (this is usually set via DISTRO_FEATURES, but GL is weird in our setup)
# this fails due to something with pixman
# PACKAGECONFIG_append_pn-qemu-native = " virglrenderer glx"
#

# setup qemuboot
IMAGE_CLASSES += "qemuboot"
```
